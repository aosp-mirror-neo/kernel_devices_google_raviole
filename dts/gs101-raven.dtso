// SPDX-License-Identifier: GPL-2.0-only
/*
 * Raven Device Tree Overlay
 *
 * Copyright 2021-2023 Google LLC
 * Copyright 2023-2025 Linaro Ltd
 */

/dts-v1/;
/plugin/;

/ {
	board_id = <0x20204>;
	board_rev = <0x10000>;
	fragment@boardbase {
		target-path="/";
		__overlay__ {
			model = "Raven Overlay";
			compatible = "google,gs101-raven", "google,gs101";
		};
	};
};

&cont_splash_mem {
	reg = <0x0 0xfac00000 (1440 * 3120 * 4)>;
	status = "okay";
};

&framebuffer0 {
	width = <1440>;
	height = <3120>;
	stride = <(1440 * 4)>;
	format = "a8r8g8b8";
	status = "okay";
};

#include "gs101-common.dtsi"
